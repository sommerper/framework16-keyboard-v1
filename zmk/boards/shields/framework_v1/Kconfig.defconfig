## zmk/boards/shields/framework_v1/Kconfig.defconfig
```kconfig
# Copyright (c) 2021 The ZMK Contributors
# SPDX-License-Identifier: MIT

if SHIELD_FRAMEWORK_V1

config ZMK_KEYBOARD_NAME
    default "Framework v1 Keyboard"

endif
```

## zmk/boards/shields/framework_v1/Kconfig.shield
```kconfig
# Copyright (c) 2021 The ZMK Contributors
# SPDX-License-Identifier: MIT

config SHIELD_FRAMEWORK_V1
    def_bool $(shields_list_contains,framework_v1)
```
